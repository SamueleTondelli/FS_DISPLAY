# file: Display_Software.ioc
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ADC1.Channel-1\#ChannelRegularConversion=ADC_CHANNEL_TEMPSENSOR
ADC1.ClockPrescaler=ADC_CLOCK_SYNC_PCLK_DIV8
ADC1.InjNumberOfConversion=0
ADC1.NbrOfConversionFlag=1
ADC1.Rank-1\#ChannelRegularConversion=1
ADC1.SamplingTime-1\#ChannelRegularConversion=ADC_SAMPLETIME_480CYCLES
ADC1.master=1
ADC2.Channel-0\#ChannelRegularConversion=ADC_CHANNEL_15
ADC2.ClockPrescaler=ADC_CLOCK_SYNC_PCLK_DIV8
ADC2.NbrOfConversionFlag=1
ADC2.Rank-0\#ChannelRegularConversion=1
ADC2.SamplingTime-0\#ChannelRegularConversion=ADC_SAMPLETIME_3CYCLES
ADC3.Channel-0\#ChannelRegularConversion=ADC_CHANNEL_13
ADC3.ClockPrescaler=ADC_CLOCK_SYNC_PCLK_DIV8
ADC3.NbrOfConversion=1
ADC3.NbrOfConversionFlag=1
ADC3.Rank-0\#ChannelRegularConversion=1
ADC3.SamplingTime-0\#ChannelRegularConversion=ADC_SAMPLETIME_3CYCLES
ADC3.ScanConvMode=ADC_SCAN_DISABLE
CAN1.AWUM=DISABLE
CAN1.BS1=CAN_BS1_3TQ
CAN1.BS2=CAN_BS2_2TQ
CAN1.CalculateBaudRate=999999
CAN1.CalculateTimeBit=1000
CAN1.CalculateTimeQuantum=166.66666666666669
CAN1.Prescaler=9
CAN1.RFLM=DISABLE
CAN1.SJW=CAN_SJW_2TQ
CAN2.BS1=CAN_BS1_6TQ
CAN2.BS2=CAN_BS2_2TQ
CAN2.CalculateBaudRate=1000000
CAN2.CalculateTimeBit=1000
CAN2.CalculateTimeQuantum=111.11111111111111
CAN2.Prescaler=6
CAN3.BS1=CAN_BS1_6TQ
CAN3.BS2=CAN_BS2_2TQ
CAN3.CalculateBaudRate=1000000
CAN3.CalculateTimeBit=1000
CAN3.CalculateTimeQuantum=111.11111111111111
CAN3.Prescaler=6
CORTEX_M7.ART_ACCLERATOR_ENABLE=1
CORTEX_M7.CPU_DCache=Enabled
CORTEX_M7.CPU_ICache=Enabled
CORTEX_M7.PREFETCH_ENABLE=1
DMA2D.ColorMode=DMA2D_OUTPUT_ARGB8888
FMC.CASLatency1=FMC_SDRAM_CAS_LATENCY_2
FMC.ExitSelfRefreshDelay1=7
FMC.LoadToActiveDelay1=2
FMC.RCDDelay1=2
FMC.RPDelay1=2
FMC.ReadBurst1=FMC_SDRAM_RBURST_ENABLE
FMC.ReadPipeDelay1=FMC_SDRAM_RPIPE_DELAY_0
FMC.RowCycleDelay1=7
FMC.SDClockPeriod1=FMC_SDRAM_CLOCK_PERIOD_2
FMC.SelfRefreshTime1=4
FMC.WriteRecoveryTime1=3
IWDG.Prescaler=IWDG_PRESCALER_32
IWDG.Reload=1000
IWDG.Window=1000
LTDC.ActiveH=272
LTDC.ActiveW=480
LTDC.Alpha_L0=255
LTDC.Alpha_L1=255
LTDC.BlendingFactor1_L0=LTDC_BLENDING_FACTOR1_PAxCA
LTDC.BlendingFactor1_L1=LTDC_BLENDING_FACTOR1_PAxCA
LTDC.BlendingFactor2_L0=LTDC_BLENDING_FACTOR2_PAxCA
LTDC.BlendingFactor2_L1=LTDC_BLENDING_FACTOR2_PAxCA
LTDC.FBStartAdress_L0=0xC0000000
LTDC.FBStartAdress_L1=0x60000000
LTDC.HBP=13
LTDC.HFP=32
LTDC.HSync=41
LTDC.ImageHeight_L0=272
LTDC.ImageHeight_L1=272
LTDC.ImageWidth_L0=480
LTDC.Layers=0
LTDC.PixelFormat_L0=LTDC_PIXEL_FORMAT_ARGB8888
LTDC.PixelFormat_L1=LTDC_PIXEL_FORMAT_ARGB8888
LTDC.VBP=2
LTDC.VFP=2
LTDC.VSync=10
LTDC.WindowX1_L0=480
LTDC.WindowX1_L1=480
LTDC.WindowY1_L0=272
LTDC.WindowY1_L1=272
Mcu.Family=STM32F7
Mcu.Name=STM32F769B(G-I)Tx
Mcu.Package=LQFP208
NVIC.CAN1_RX0_IRQn=true\:0\:0\:false\:false\:true\:true\:true\:true
NVIC.PriorityGroup=NVIC_PRIORITYGROUP_4
PA0/WKUP.Mode=SYS_WakeUp0
PA0/WKUP.Signal=SYS_WKUP1
PA1.Mode=RGB888
PA1.Signal=LTDC_R2
PA10.Mode=RGB888
PA10.Signal=LTDC_B1
PA11.Mode=CAN_Activate
PA11.Signal=CAN1_RX
PA12.Mode=CAN_Activate
PA12.Signal=CAN1_TX
PA13.Mode=Trace_Asynchronous_SW
PA13.Signal=SYS_JTMS-SWDIO
PA14.Mode=Trace_Asynchronous_SW
PA14.Signal=SYS_JTCK-SWCLK
PA15.Mode=CAN_Activate
PA15.Signal=CAN3_TX
PA3.Mode=RGB888
PA3.Signal=LTDC_B5
PA4.Signal=COMP_DAC1_group
PA5.Signal=COMP_DAC2_group
PA6.Mode=RGB888
PA6.Signal=LTDC_G2
PA7.GPIO_Label=U_LED
PA7.Signal=GPIO_Output
PA8.Mode=CAN_Activate
PA8.Signal=CAN3_RX
PA9.GPIO_Label=SPARE2
PA9.Signal=GPIO_Output
PB0.Mode=RGB888
PB0.Signal=LTDC_R3
PB1.Mode=RGB888
PB1.Signal=LTDC_R6
PB10.GPIO_Speed=GPIO_SPEED_FREQ_VERY_HIGH
PB10.Mode=Single Bank 1
PB10.Signal=QUADSPI_BK1_NCS
PB11.GPIO_Label=SPARE3
PB11.Signal=GPIO_Output
PB12.Mode=CAN_Activate
PB12.Signal=CAN2_RX
PB13.Mode=CAN_Activate
PB13.Signal=CAN2_TX
PB14.Mode=Asynchronous
PB14.Signal=USART1_TX
PB15.Mode=Asynchronous
PB15.Signal=USART1_RX
PB2.GPIO_Speed=GPIO_SPEED_FREQ_VERY_HIGH
PB2.Mode=Single Bank 1
PB2.Signal=QUADSPI_CLK
PB3.Mode=Trace_Asynchronous_SW
PB3.Signal=SYS_JTDO-SWO
PB4.GPIO_Label=DIG4_F
PB4.Signal=GPIO_Input
PB5.GPIO_Label=DIG3_F
PB5.Signal=GPIO_Input
PB6.GPIO_Label=DIG2_F
PB6.Signal=GPIO_Input
PB7.GPIO_Label=DIG1_F
PB7.Signal=GPIO_Input
PB8.GPIO_Label=Map_BTN_F
PB8.Signal=GPIO_Input
PB9.GPIO_Label=Disp_BTN_F
PB9.Signal=GPIO_Input
PC0.Mode=RGB888
PC0.Signal=LTDC_R5
PC1.GPIO_Label=TEMP
PC1.Signal=SharedAnalog_PC1
PC10.Mode=SD_4_bits_Wide_bus
PC10.Signal=SDMMC1_D2
PC11.Mode=SD_4_bits_Wide_bus
PC11.Signal=SDMMC1_D3
PC12.Mode=SD_4_bits_Wide_bus
PC12.Signal=SDMMC1_CK
PC2.GPIO_Label=AN1_F
PC2.Signal=SharedAnalog_PC2
PC3.GPIO_Label=AN2_F
PC3.Signal=SharedAnalog_PC3
PC4.GPIO_Label=AN3_F
PC4.Signal=SharedAnalog_PC4
PC5.GPIO_Label=AN4_F
PC5.Signal=SharedAnalog_PC5
PC6.GPIO_Label=SPARE4
PC6.Signal=GPIO_Output
PC8.Mode=SD_4_bits_Wide_bus
PC8.Signal=SDMMC1_D0
PC9.Mode=SD_4_bits_Wide_bus
PC9.Signal=SDMMC1_D1
PD0.Signal=FMC_D2_DA2
PD1.Signal=FMC_D3_DA3
PD10.Signal=FMC_D15_DA15
PD11.GPIO_Label=_5V_OUT2
PD11.Signal=GPIO_Output
PD12.GPIO_Label=_5V_OUT1
PD12.Signal=GPIO_Output
PD13.GPIO_Label=MAP_OUT
PD13.Signal=GPIO_Output
PD14.Signal=FMC_D0_DA0
PD15.Signal=FMC_D1_DA1
PD2.Mode=SD_4_bits_Wide_bus
PD2.Signal=SDMMC1_CMD
PD3.Mode=RGB888
PD3.Signal=LTDC_G7
PD4.GPIO_Label=_5V_OUT4
PD4.Signal=GPIO_Output
PD5.GPIO_Label=_5V_OUT3
PD5.Signal=GPIO_Output
PD6.Mode=RGB888
PD6.Signal=LTDC_B2
PD7.GPIO_Label=SPARE9
PD7.Signal=GPIO_Output
PD8.Signal=FMC_D13_DA13
PD9.Signal=FMC_D14_DA14
PE0.Signal=FMC_NBL0
PE1.Signal=FMC_NBL1
PE10.Signal=FMC_D7_DA7
PE11.Signal=FMC_D8_DA8
PE12.Signal=FMC_D9_DA9
PE13.Signal=FMC_D10_DA10
PE14.Signal=FMC_D11_DA11
PE15.Signal=FMC_D12_DA12
PE2.GPIO_Speed=GPIO_SPEED_FREQ_VERY_HIGH
PE2.Mode=Single Bank 1
PE2.Signal=QUADSPI_BK1_IO2
PE3.GPIO_Label=SPARE10
PE3.Signal=GPIO_Output
PE4.Mode=RGB888
PE4.Signal=LTDC_B0
PE5.Mode=RGB888
PE5.Signal=LTDC_G0
PE6.Mode=RGB888
PE6.Signal=LTDC_G1
PE7.Signal=FMC_D4_DA4
PE8.Signal=FMC_D5_DA5
PE9.Signal=FMC_D6_DA6
PF0.Signal=FMC_A0
PF1.Signal=FMC_A1
PF10.Mode=RGB888
PF10.Signal=LTDC_DE
PF11.Signal=FMC_SDNRAS
PF12.Signal=FMC_A6
PF13.Signal=FMC_A7
PF14.Signal=FMC_A8
PF15.Signal=FMC_A9
PF2.Signal=FMC_A2
PF3.Signal=FMC_A3
PF4.Signal=FMC_A4
PF5.Signal=FMC_A5
PF6.GPIO_Speed=GPIO_SPEED_FREQ_VERY_HIGH
PF6.Mode=Single Bank 1
PF6.Signal=QUADSPI_BK1_IO3
PF7.GPIO_Label=LCD_BL_CTRL
PF7.Signal=GPIO_Output
PF8.GPIO_Speed=GPIO_SPEED_FREQ_VERY_HIGH
PF8.Mode=Single Bank 1
PF8.Signal=QUADSPI_BK1_IO0
PF9.GPIO_Speed=GPIO_SPEED_FREQ_VERY_HIGH
PF9.Mode=Single Bank 1
PF9.Signal=QUADSPI_BK1_IO1
PG0.Signal=FMC_A10
PG1.Signal=FMC_A11
PG10.GPIO_Label=uSD_DETECT
PG10.GPIO_PuPd=GPIO_PULLUP
PG10.Signal=GPIO_Input
PG11.GPIO_Label=SPARE13
PG11.Signal=GPIO_Output
PG12.Mode=RGB888
PG12.Signal=LTDC_B4
PG13.GPIO_Label=SPARE12
PG13.Signal=GPIO_Output
PG14.GPIO_Label=SPARE11
PG14.Signal=GPIO_Output
PG15.Signal=FMC_SDNCAS
PG2.Signal=FMC_A12
PG3.GPIO_Label=SPARE16
PG3.Signal=GPIO_Output
PG4.Signal=FMC_A14_BA0
PG5.Signal=FMC_A15_BA1
PG6.Mode=RGB888
PG6.Signal=LTDC_R7
PG7.GPIO_Label=SPARE15
PG7.Signal=GPIO_Output
PG8.Signal=FMC_SDCLK
PG9.GPIO_Label=SPARE14
PG9.Signal=GPIO_Output
PH0/OSC_IN.Mode=HSE-External-Oscillator
PH0/OSC_IN.Signal=RCC_OSC_IN
PH1/OSC_OUT.Mode=HSE-External-Oscillator
PH1/OSC_OUT.Signal=RCC_OSC_OUT
PH10.Signal=FMC_D18
PH11.Signal=FMC_D19
PH12.Signal=FMC_D20
PH13.Signal=FMC_D21
PH14.Signal=FMC_D22
PH15.Signal=FMC_D23
PH2.Mode=SdramChipSelect1_1
PH2.Signal=FMC_SDCKE0
PH3.Mode=SdramChipSelect1_1
PH3.Signal=FMC_SDNE0
PH4.Mode=RGB888
PH4.Signal=LTDC_G5
PH5.Signal=FMC_SDNWE
PH6.GPIO_Label=SPARE19
PH6.Signal=GPIO_Output
PH7.GPIO_Label=SPARE18
PH7.Signal=GPIO_Output
PH8.Signal=FMC_D16
PH9.Signal=FMC_D17
PI0.Signal=FMC_D24
PI1.Signal=FMC_D25
PI10.Signal=FMC_D31
PI11.Mode=RGB888
PI11.Signal=LTDC_G6
PI12.Mode=RGB888
PI12.Signal=LTDC_HSYNC
PI13.Mode=RGB888
PI13.Signal=LTDC_VSYNC
PI14.Mode=RGB888
PI14.Signal=LTDC_CLK
PI15.Mode=RGB888
PI15.Signal=LTDC_R0
PI2.Signal=FMC_D26
PI3.Signal=FMC_D27
PI4.Signal=FMC_NBL2
PI5.Signal=FMC_NBL3
PI6.Signal=FMC_D28
PI7.Signal=FMC_D29
PI9.Signal=FMC_D30
PJ0.Mode=RGB888
PJ0.Signal=LTDC_R1
PJ1.GPIO_Label=SPARE25
PJ1.Signal=GPIO_Output
PJ12.Mode=RGB888
PJ12.Signal=LTDC_G3
PJ13.Mode=RGB888
PJ13.Signal=LTDC_G4
PJ14.GPIO_Label=SPARE21
PJ14.Signal=GPIO_Output
PJ15.Mode=RGB888
PJ15.Signal=LTDC_B3
PJ2.GPIO_Label=SPARE24
PJ2.Signal=GPIO_Output
PJ3.Mode=RGB888
PJ3.Signal=LTDC_R4
PJ4.GPIO_Label=SPARE23
PJ4.Signal=GPIO_Output
PK3.GPIO_Label=LCD_DISP
PK3.Signal=GPIO_Output
PK4.GPIO_Label=SPARE27
PK4.Signal=GPIO_Output
PK5.Mode=RGB888
PK5.Signal=LTDC_B6
PK6.Mode=RGB888
PK6.Signal=LTDC_B7
PK7.GPIO_Label=SPARE26
PK7.Signal=GPIO_Output
ProjectManager.HeapSize=0x200
ProjectManager.StackSize=0x400
ProjectManager.TargetToolchain=STM32CubeIDE
QUADSPI.ChipSelectHighTime=QSPI_CS_HIGH_TIME_6_CYCLE
QUADSPI.ClockPrescaler=1
QUADSPI.FifoThreshold=4
QUADSPI.FlashSize=23
QUADSPI.SampleShifting=QSPI_SAMPLE_SHIFTING_HALFCYCLE
RCC.AHBFreq_Value=216000000
RCC.APB1CLKDivider=RCC_HCLK_DIV4
RCC.APB1Freq_Value=54000000
RCC.APB1TimFreq_Value=108000000
RCC.APB2CLKDivider=RCC_HCLK_DIV2
RCC.APB2Freq_Value=108000000
RCC.APB2TimFreq_Value=216000000
RCC.CortexFreq_Value=216000000
RCC.HCLKFreq_Value=216000000
RCC.HSE_VALUE=25000000
RCC.HSI_VALUE=16000000
RCC.LSE_VALUE=32768
RCC.PLL48CLockSelection=RCC_CLK48SOURCE_PLLSAIP
RCC.PLLM=25
RCC.PLLN=432
RCC.PLLQ=8
RCC.PLLSAIP=RCC_PLLSAIP_DIV4
RCC.PLLSAIR=3
RCC.PLLSAIRDiv=RCC_PLLSAIDIVR_4
RCC.PLLSourceVirtual=RCC_PLLSOURCE_HSE
RCC.SDMMCClockSelection=RCC_SDMMC1CLKSOURCE_CLK48
RCC.SYSCLKFreq_VALUE=216000000
RCC.SYSCLKSource=RCC_SYSCLKSOURCE_PLLCLK
RCC.USBFreq_Value=48000000
RCC.VCOOutputFreq_Value=432000000
SH.COMP_DAC1_group.0=DAC_OUT1,DAC_OUT1
SH.COMP_DAC2_group.0=DAC_OUT2,DAC_OUT2
SH.FMC_A0.0=FMC_A0,12b-sda1
SH.FMC_A1.0=FMC_A1,12b-sda1
SH.FMC_A10.0=FMC_A10,12b-sda1
SH.FMC_A11.0=FMC_A11,12b-sda1
SH.FMC_A12.0=FMC_A12
SH.FMC_A14_BA0.0=FMC_BA0,FourSdramBanks1
SH.FMC_A15_BA1.0=FMC_BA1,FourSdramBanks1
SH.FMC_A2.0=FMC_A2,12b-sda1
SH.FMC_A3.0=FMC_A3,12b-sda1
SH.FMC_A4.0=FMC_A4,12b-sda1
SH.FMC_A5.0=FMC_A5,12b-sda1
SH.FMC_A6.0=FMC_A6,12b-sda1
SH.FMC_A7.0=FMC_A7,12b-sda1
SH.FMC_A8.0=FMC_A8,12b-sda1
SH.FMC_A9.0=FMC_A9,12b-sda1
SH.FMC_D0_DA0.0=FMC_D0,sd-32b-d1
SH.FMC_D10_DA10.0=FMC_D10,sd-32b-d1
SH.FMC_D11_DA11.0=FMC_D11,sd-32b-d1
SH.FMC_D12_DA12.0=FMC_D12,sd-32b-d1
SH.FMC_D13_DA13.0=FMC_D13,sd-32b-d1
SH.FMC_D14_DA14.0=FMC_D14,sd-32b-d1
SH.FMC_D15_DA15.0=FMC_D15,sd-32b-d1
SH.FMC_D16.0=FMC_D16,sd-32b-d1
SH.FMC_D17.0=FMC_D17,sd-32b-d1
SH.FMC_D18.0=FMC_D18,sd-32b-d1
SH.FMC_D19.0=FMC_D19,sd-32b-d1
SH.FMC_D1_DA1.0=FMC_D1,sd-32b-d1
SH.FMC_D20.0=FMC_D20,sd-32b-d1
SH.FMC_D21.0=FMC_D21,sd-32b-d1
SH.FMC_D22.0=FMC_D22,sd-32b-d1
SH.FMC_D23.0=FMC_D23,sd-32b-d1
SH.FMC_D24.0=FMC_D24,sd-32b-d1
SH.FMC_D25.0=FMC_D25,sd-32b-d1
SH.FMC_D26.0=FMC_D26,sd-32b-d1
SH.FMC_D27.0=FMC_D27,sd-32b-d1
SH.FMC_D28.0=FMC_D28,sd-32b-d1
SH.FMC_D29.0=FMC_D29,sd-32b-d1
SH.FMC_D2_DA2.0=FMC_D2,sd-32b-d1
SH.FMC_D30.0=FMC_D30,sd-32b-d1
SH.FMC_D31.0=FMC_D31,sd-32b-d1
SH.FMC_D3_DA3.0=FMC_D3,sd-32b-d1
SH.FMC_D4_DA4.0=FMC_D4,sd-32b-d1
SH.FMC_D5_DA5.0=FMC_D5,sd-32b-d1
SH.FMC_D6_DA6.0=FMC_D6,sd-32b-d1
SH.FMC_D7_DA7.0=FMC_D7,sd-32b-d1
SH.FMC_D8_DA8.0=FMC_D8,sd-32b-d1
SH.FMC_D9_DA9.0=FMC_D9,sd-32b-d1
SH.FMC_NBL0.0=FMC_NBL0,Sd4ByteEnable1
SH.FMC_NBL1.0=FMC_NBL1,Sd4ByteEnable1
SH.FMC_NBL2.0=FMC_NBL2,Sd4ByteEnable1
SH.FMC_NBL3.0=FMC_NBL3,Sd4ByteEnable1
SH.FMC_SDCLK.0=FMC_SDCLK,12b-sda1
SH.FMC_SDNCAS.0=FMC_SDNCAS,12b-sda1
SH.FMC_SDNRAS.0=FMC_SDNRAS,12b-sda1
SH.FMC_SDNWE.0=FMC_SDNWE,12b-sda1
SH.SharedAnalog_PC1.0=GPIO_Analog
SH.SharedAnalog_PC1.1=ADC3_IN11,IN11
SH.SharedAnalog_PC2.0=GPIO_Analog
SH.SharedAnalog_PC2.1=ADC3_IN12,IN12
SH.SharedAnalog_PC3.0=GPIO_Analog
SH.SharedAnalog_PC3.1=ADC3_IN13,IN13
SH.SharedAnalog_PC4.0=GPIO_Analog
SH.SharedAnalog_PC4.1=ADC2_IN14,IN14
SH.SharedAnalog_PC5.0=GPIO_Analog
SH.SharedAnalog_PC5.1=ADC2_IN15,IN15
USART1.BaudRate=6400
USART1.VirtualMode-Asynchronous=VM_ASYNC
VP_ADC1_TempSens_Input.Mode=IN-TempSens
VP_CRC_VS_CRC.Mode=CRC_Activate
VP_DMA2D_VS_DMA2D.Mode=DMA2D_Activate
VP_IWDG_VS_IWDG.Mode=IWDG_Activate
board=custom

// file: Core/Src/main.c
/* USER CODE BEGIN Header */
/**
 ******************************************************************************
 * @file           : main.c
 * @brief          : Main program body
 ******************************************************************************
 * @attention
 *
 * <h2><center>&copy; Copyright (c) 2021 STMicroelectronics.
 * All rights reserved.</center></h2>
 *
 * This software component is licensed by ST under BSD 3-Clause license,
 * the "License"; You may not use this file except in compliance with the
 * License. You may obtain a copy of the License at:
 *                        opensource.org/licenses/BSD-3-Clause
 *
 ******************************************************************************
 */
/* USER CODE END Header */
#include "main.h"
#include "adc.h"
#include "can.h"
#include "crc.h"
#include "dac.h"
#include "dma2d.h"
#include "iwdg.h"
#include "ltdc.h"
#include "quadspi.h"
#include "sdmmc.h"
#include "usart.h"
#include "gpio.h"
#include "fmc.h"

/* USER CODE BEGIN Includes */

#include "DISPLAY_GUI.h"

#include "MDM_Functions.h"

#ifndef __CAR_DATA_H
#include "CAR_DATA.h"
#endif

#include "string.h"

/* USER CODE END Includes */

/* USER CODE BEGIN PV */

uint8_t Error_Handler_Code = 0;

uint8_t startingProcedureFlag = 0;

uint32_t loopTime = 0;

uint32_t loopTimeMax = 0;
uint32_t loopTimeMaxResetMillis = 0;
#define loopTimeMaxResetDelay		1000

float loopTimeAvg = 0;

#if HQ_AVG_LOOP_TIME_ENABLE == 0
#define avgLoopNumber				100		//100
#else
#define avgLoopNumber				1000		//1000
#endif

uint32_t loopTimeAvgMem[avgLoopNumber];

uint8_t LCD_LAYER0_BUFFER[LCD_FULLSCREEN_ARGB_BUFFER_SIZE] __attribute__((section(".SDRAM")));
uint8_t LCD_LAYER1_BUFFER[LCD_FULLSCREEN_ARGB_BUFFER_SIZE] __attribute__((section(".SDRAM")));

extern GUI_CONST_STORAGE GUI_BITMAP bmScuderia_Ferrari_F1_2018;

//uint8_t memTest1 __attribute__((section(".SDRAM")));

extern uint8_t TxData_CAN1[8];
extern uint8_t dataRX_SAVED[8];

//old car data (keep for old code)
float 		vBat 					= 99;
int32_t 	gear 					= 0;
float 		tOil 					= 99;
float 		tWater 					= 99;
float 		tAir 					= 3;
int32_t 	drsStatus 				= 0;
int32_t 	map 					= 0;
int32_t 	map_pp					= 1; //used to have map + 1
int32_t 	tractionControl 		= 0;
float 		pOil 					= 99;
int32_t 	rpm 					= 99;
int32_t 	tps 					= 99;
int32_t 	launchControlStatus 	= 0;
int32_t 	gs 						= 0;
int32_t 	pedal 					= 99;
float 		speed 					= 99;
int32_t 	steer 					= 0;
int32_t		slip 					= 0;
int32_t	 	brake 					= 0;
float		pFuel 					= 99;

int32_t defaultDataPointed = 13;

//antideb
uint8_t buttonStateMAP = 0;            // the current reading from the input pin
uint8_t lastButtonStateMAP = 0;  	// the previous reading from the input pin
uint8_t MAPbtn = 0;

uint32_t lastDebounceTimeMAP = 0;  	// the last time the output pin was toggled

uint8_t buttonStateDISP = 0;           // the current reading from the input pin
uint8_t lastButtonStateDISP = 0;  	// the previous reading from the input pin
uint8_t DISPbtn = 0;

uint32_t lastDebounceTimeDISP = 0;  // the last time the output pin was toggled

uint32_t debounceDelay = 100; 		// the debounce time; increase if the output flickers //it was 250 @ 30/11/21

GPIO_EdgeTypeDef displayButton = { 0 };
#define displayButtonDelay				100

uint8_t markState = 0;
uint32_t markMillis = 0;
#define markSendDelay					100

/* USER CODE END PV */

void SystemClock_Config(void);
/* USER CODE BEGIN PFP */

void dashboardLedControl(void);

/* USER CODE END PFP */

/* USER CODE BEGIN 0 */

uint8_t dataWrite[100] = "test qspi data write";
uint8_t dataRead[100];

/* USER CODE END 0 */

int main(void)
{

  /* Enable I-Cache---------------------------------------------------------*/
  SCB_EnableICache();

  /* Enable D-Cache---------------------------------------------------------*/
  SCB_EnableDCache();

  /* MCU Configuration--------------------------------------------------------*/

  /* Reset of all peripherals, Initializes the Flash interface and the Systick. */
  HAL_Init();

  /* Configure the system clock */
  SystemClock_Config();

  /* USER CODE BEGIN SysInit */

	if (0)
	{
  /* USER CODE END SysInit */

  /* Initialize all configured peripherals */
  MX_GPIO_Init();
  MX_ADC1_Init();
  MX_CAN1_Init();
  MX_CAN2_Init();
  MX_CAN3_Init();
  MX_DAC_Init();
  MX_FMC_Init();
  MX_LTDC_Init();
  MX_QUADSPI_Init();
  MX_SDMMC1_SD_Init();
  MX_USART1_UART_Init();
  MX_DMA2D_Init();
  MX_CRC_Init();
  MX_IWDG_Init();
  MX_ADC2_Init();
  MX_ADC3_Init();
  /* USER CODE BEGIN 2 */
	}

	MX_GPIO_Init();
	DisplayOFF();
	MX_ADC1_Init();
	//MX_ADC2_Init();
	MX_ADC3_Init();
	MX_CAN1_Init();
	MX_CAN2_Init();
	//MX_CAN3_Init();
	//MX_DAC_Init();
	//MX_SDMMC1_SD_Init();
	//MX_USART1_UART_Init();
	MX_DMA2D_Init();
	MX_CRC_Init();
	MX_FMC_Init();
	MX_LTDC_Init();
	MDM_LCD_SetLayerVisible(0, DISABLE);
	DisplayOFF();
	//MX_QUADSPI_Init();

	// QSPI meme test BEGIN
//
//	if(CSP_QUADSPI_Init() != HAL_OK)
//	{
//		Error_Handler();
//	}
//
//	if(CSP_QSPI_Erase_Chip() != HAL_OK)
//	{
//		Error_Handler();
//	}
//
//
//
//
//	if(CSP_QSPI_Write(dataWrite, 0x00, 9) != HAL_OK)
//	{
//		Error_Handler();
//	}
//
//	if(CSP_QSPI_Read(dataRead, 0x00, 100) != HAL_OK)
//	{
//		Error_Handler();
//	}
//
//
//	if(dataWrite[0] == dataRead[0])
//	{
//		DisplayOFF();
//		HAL_Delay(500);
//		DisplayON();
//		HAL_Delay(500);
//		DisplayOFF();
//		HAL_Delay(500);
//		DisplayON();
//	}
//
//

	// QSPI meme test END

	HAL_GPIO_WritePin(_5V_OUT1_GPIO_Port, _5V_OUT1_Pin, 1);

	CAR_CAN_Init();

	CAR_DATA_Init();

	MX_IWDG_Init();

	displayButton.GPIOx = Disp_BTN_F_GPIO_Port;
	displayButton.GPIO_Pin = Disp_BTN_F_Pin;
	displayButton.delay = displayButtonDelay;

	DisplayGui_Init();

	HAL_ADC_Start(&hadc3);

	__HAL_IWDG_RELOAD_COUNTER(&hiwdg);
	HAL_Delay(150);							//needed to eliminate white flash of the display at the startup (needed at least 150 ms)
	__HAL_IWDG_RELOAD_COUNTER(&hiwdg);

	DisplayON();

	HAL_GPIO_WritePin(_5V_OUT1_GPIO_Port, _5V_OUT1_Pin, 0);

  /* USER CODE END 2 */

  /* Infinite loop */
	while (1) {

    /* USER CODE BEGIN 3 */

		// loop time calculation BEGIN

		static uint32_t loopTimeBegin = 0;
		static uint16_t loopTimeAvgPointer = 0;
		//uint32_t loopTimeAvgTemp = 0;

		static uint32_t loopTimeAvgTemp = 0;

		loopTime = millis - loopTimeBegin;
		loopTimeBegin = millis;

		loopTimeAvgTemp = loopTimeAvgTemp - loopTimeAvgMem[loopTimeAvgPointer];
		loopTimeAvgMem[loopTimeAvgPointer] = loopTime;
		loopTimeAvgTemp = loopTimeAvgTemp + loopTime;

		loopTimeAvgPointer++;

		if(loopTimeAvgPointer >= avgLoopNumber)
			loopTimeAvgPointer = 0;

		loopTimeAvg = (float)loopTimeAvgTemp / avgLoopNumber;

		if(millis >= loopTimeMaxResetMillis + loopTimeMaxResetDelay)
		{
			loopTimeMax = 0;
			loopTimeMaxResetMillis = millis;
		}

		loopTimeMax = max(loopTimeMax, loopTime);

		// loop time calculation END

		readMcuTemperature();

		CAR_DATA_Read();
		CAR_DATA_Calculations();

		if(DEBUG_MODE == 0)
		{
			tractionAcquisition();
		}

		// Mark button BEGIN

		if (millis >= markMillis + markSendDelay)
		{

			markState = HAL_GPIO_ReadPin(DIG1_F_GPIO_Port, DIG1_F_Pin);

			TxData_CAN1[0] = markState; //MARK TO ECU
			TxData_CAN1[1] = MCU_temperature; //SEND MCU TEMP FOR DEBUGGING
			TxData_CAN1[2] = dataRX_SAVED[0]; //STEER DATA FROM CAN2 TO CAN1 FOR DRS
			TxData_CAN1[3] = dataRX_SAVED[1]; //AS ABOVE
			//ADD Y ACCEL FROM CAN2 TO CAN1 FOR DRS
			TxData_CAN1[4]=dataRX_SAVED[2];
			TxData_CAN1[5]=dataRX_SAVED[3];

			if(DEBUG_MODE == 0)
			{
				CAR_Data.steer.intData = TxData_CAN1[2]<<8|TxData_CAN1[3];

				CAR_Data.steer.floatData = CAR_Data.steer.intData;
				CAR_Data.steer.oldTimeData = CAR_Data.steer.lastTimeData;
				CAR_Data.steer.lastTimeData = millis;

				steer = CAR_Data.steer.intData;
			}

			HAL_CAN_AddTxMessage(&hcan1, &pHeader_CAN1, TxData_CAN1, &TxMailbox_CAN1);		//WARNING: disable only for DEBUG

			markMillis = millis;
		}

		// Mark button END

		// Display debounce section BEGIN

		uint8_t readingDISP = HAL_GPIO_ReadPin(Disp_BTN_F_GPIO_Port, Disp_BTN_F_Pin);

		// check to see if you just pressed the button
		// (i.e. the input went from LOW to HIGH), and you've waited long enough
		// since the last press to ignore any noise:

		// If the switch changed, due to noise or pressing:
		if (readingDISP != lastButtonStateDISP) {
			// reset the debouncing timer
			lastDebounceTimeDISP = millis;
		}

		if ((millis - lastDebounceTimeDISP) > debounceDelay) {
			// whatever the reading is at, it's been there for longer than the debounce
			// delay, so take it as the actual current state:

			// if the button state has changed:
			if (readingDISP != buttonStateDISP) {
				buttonStateDISP = readingDISP;

				// only toggle the LED if the new button state is HIGH
				if (buttonStateDISP == 1) {
					//HAL_GPIO_TogglePin(MAP_OUT_GPIO_Port, MAP_OUT_Pin);
					//MAPbtn = !MAPbtn;
					DISPbtn = !DISPbtn;
				}
			}
		}

		//if(GPIO_AdvancedRead(&displayButton) == GPIO_FALL)
		//DISPbtn = !DISPbtn;

		lastButtonStateDISP = readingDISP;

		// Display debounce section END

		//Display page selection BEGIN
		static uint8_t flagIncrementoPagina = 0;
		static uint8_t flagDecrementoPagina = 0;
		static uint8_t paginaAttivata = 1;

		if(MAP_CHANGE_ENABLE == DISABLE)
		{
			if (DISPbtn == 1 && flagIncrementoPagina == 0)
			{
				paginaAttivata--;
				flagIncrementoPagina = 1;
			}

			if (DISPbtn == 0 && flagIncrementoPagina == 1)
			{
				paginaAttivata--;
				flagIncrementoPagina = 0;
			}

			if (MAPbtn == 1 && flagDecrementoPagina == 0) {
				paginaAttivata++;
				flagDecrementoPagina = 1;
			}

			if (MAPbtn == 0 && flagDecrementoPagina == 1) {
				paginaAttivata++;
				flagDecrementoPagina = 0;
			}
		}
		else
		{
			if (DISPbtn == 1 && flagIncrementoPagina == 0)
			{
				paginaAttivata++;
				flagIncrementoPagina = 1;
			}

			if (DISPbtn == 0 && flagIncrementoPagina == 1)
			{
				paginaAttivata++;
				flagIncrementoPagina = 0;
			}
		}

		if (paginaAttivata > 5)
		{
			paginaAttivata = 1;
		}
		else if (paginaAttivata < 1)
		{
			paginaAttivata = 5;
		}

		//paginaAttivata = 2;		//WARNING: SOLO DEBUG

		static uint8_t changePageFloag = 0;

		if (selectedGui != GuiAlarm && DEBUG_MODE == 0)
		{
			if(selectedGui_old != GuiAlarm && changePageFloag)
			{
				switch (paginaAttivata)
				{
					case 1:
						selectedGui = GuiDrive1;					//ENDURANCE
						break;

					case 2:
						//selectedGui = GuiDrive2;
						selectedGui = GuiOld1;						//AUTOCROSS
						break;

					case 3:
						selectedGui = GuiHandlingCurvesTest;		//SKIDPAD
						break;

					case 4:
						selectedGui = GuiAcceleration;				//ACCELERATION
						break;

					case 5:
						selectedGui = GuiCarSetup;
						break;

					case 6:
						selectedGui = GuiOld1;
						break;

					default:
						selectedGui = GuiDrive1;

				}

				changePageFloag = 0;
			}
			else
			{
				static uint32_t millisWaitToChangePage = 0;

				if(millisWaitToChangePage == 0)
					millisWaitToChangePage = millis;

				if(millis - millisWaitToChangePage >= 50)
				{
					millisWaitToChangePage = 0;
					changePageFloag = 1;
				}
			}
		}

		//Display page selection END

		// MAP debounce section BEGIN

		uint8_t readingMAP = HAL_GPIO_ReadPin(Map_BTN_F_GPIO_Port, Map_BTN_F_Pin);

		// check to see if you just pressed the button
		// (i.e. the input went from LOW to HIGH), and you've waited long enough
		// since the last press to ignore any noise:

		// If the switch changed, due to noise or pressing:
		if (readingMAP != lastButtonStateMAP)
		{
			// reset the debouncing timer
			lastDebounceTimeMAP = millis;
		}

		if ((millis - lastDebounceTimeMAP) > debounceDelay)
		{
			// whatever the reading is at, it's been there for longer than the debounce
			// delay, so take it as the actual current state:

			// if the button state has changed:
			if (readingMAP != buttonStateMAP)
			{
				buttonStateMAP = readingMAP;

				// only toggle the LED if the new button state is HIGH
				if (buttonStateMAP == 1)
				{
					//HAL_GPIO_TogglePin(MAP_OUT_GPIO_Port, MAP_OUT_Pin);
					MAPbtn = !MAPbtn;
				}
			}
		}

		if(MAP_CHANGE_ENABLE == ENABLE)
			HAL_GPIO_WritePin(MAP_OUT_GPIO_Port, MAP_OUT_Pin, !MAPbtn);
		else
			HAL_GPIO_WritePin(MAP_OUT_GPIO_Port, MAP_OUT_Pin, 1);

		//map = MAPbtn;
		CAR_Data.map.intData = !HAL_GPIO_ReadPin(MAP_OUT_GPIO_Port, MAP_OUT_Pin);
		map = CAR_Data.map.intData;

		CAR_Data.map.floatData = CAR_Data.map.intData;

		map_pp = CAR_Data.map.intData + 1;
		// save the reading. Next time through the loop, it'll be the lastButtonState:
		lastButtonStateMAP = readingMAP;

		// MAP debounce section END

		//MDM Debug Code BEGIN

#if DEBUG_MODE == 1

		static uint8_t debugModeSetupFlag = 0;

		if(debugModeSetupFlag == 0)
		{
			debugModeSetupFlag = 1;

			//selectedGui = GuiPowertrainData1;		//Warning: only for DEBUG

			//selectedGui = GuiOld1;
			//selectedGui = GuiOld2;
			//selectedGui = GuiAcceleration;

			selectedGui = GuiDrive1;
			//selectedGui = GuiDrive2;

			//selectedGui = GuiHandlingCurvesTest;

			//selectedGui = GuiCarSetup;

			//CAN_DATA_GuiPopUp_Disable(0);		//Traction, 			change
			//CAN_DATA_GuiPopUp_Disable(1);		//MAP,				 	change

			//CAN_DATA_GuiPopUp_Disable(2);		//Water Temperature, 	range
			//CAN_DATA_GuiPopUp_Disable(3);		//Oil Temperature,		range
			//CAN_DATA_GuiPopUp_Disable(4);		//Fuel Pressure, 		range
			//CAN_DATA_GuiPopUp_Disable(5);		//Oil Pressure, 		range
			//CAN_DATA_GuiPopUp_Disable(6);		//RPM,					range
			//CAN_DATA_GuiPopUp_Disable(7);		//BSPD,					range

			//CAN_DATA_GuiPopUp_DisableAll();

			CAR_Data.steer.floatData = steer_MIN_VALUE;
			CAR_Data.speed.floatData = 140;
		}

		if(DEBUG_BSPD == 1)
		{
			CAR_Data.brake.floatData += 0.0003;

			if(CAR_Data.brake.floatData > 20)
			{
				CAR_Data.brake.floatData = 0;
			}

			//CAR_Data.brake.floatData = 10;

			CAR_Data.brake.intData = CAR_Data.brake.floatData;
			CAR_Data.brake.oldTimeData = CAR_Data.brake.lastTimeData;
			CAR_Data.brake.lastTimeData = millis;

			CAR_Data.tps.floatData += 0.0003;

			if(CAR_Data.tps.floatData > 100)
			{
				CAR_Data.tps.floatData = 0;
			}

			CAR_Data.tps.intData = CAR_Data.tps.floatData;
			CAR_Data.tps.oldTimeData = CAR_Data.tps.lastTimeData;
			CAR_Data.tps.lastTimeData = millis;

			if(CAR_Data.BSPD_warning == 1)
			{
				CAR_Data.tps.intData = 0;
				CAR_Data.tps.floatData = 0;
			}

			goto END_OF_DEBUG_SECTION;
		}
		else
		{
			CAN_DATA_GuiPopUp_Disable(7);		//BSPD,					range
		}

/*
		static uint32_t millisPageToggle = 0;

		if(millis >= millisPageToggle + 10000)
		{
			if(selectedGui == GuiDrive1)
				selectedGui = GuiDrive2;
			else if(selectedGui == GuiDrive2)
				selectedGui = GuiHandlingCurvesTest;
			else
				selectedGui = GuiDrive1;

			millisPageToggle = millis;
		}
*/

		CAR_Data.canLastReceiveTime = millis;

		uint32_t static drsTime = 0;

		if(millis >= drsTime + 1000)
		{
			//drive1_gui_data[11].dataLogInt.number = !drive1_gui_data[11].dataLogInt.number;

			if(CAR_Data.drsStatus.intData != 0)
				CAR_Data.drsStatus.intData = 0;
			else
				CAR_Data.drsStatus.intData = 1;

			CAR_Data.drsStatus.floatData = CAR_Data.drsStatus.intData;
			CAR_Data.drsStatus.lastTimeData = millis;

			drsTime = millis;

			if(tAir < 100)
				CAR_Data.airTemp.floatData += 4.9;
			else
				tAir = 0;

			CAR_Data.airTemp.intData = CAR_Data.airTemp.floatData;
			CAR_Data.airTemp.oldTimeData = CAR_Data.airTemp.lastTimeData;
			CAR_Data.airTemp.lastTimeData = millis;
		}

		CAR_Data.waterTemp.oldTimeData = CAR_Data.waterTemp.lastTimeData;
		CAR_Data.waterTemp.floatData += 0.0001;
		CAR_Data.waterTemp.intData = CAR_Data.waterTemp.floatData;
		CAR_Data.waterTemp.lastTimeData = millis;

		if(CAR_Data.waterTemp.floatData >= 150)
			CAR_Data.waterTemp.floatData = 0;

		CAR_Data.oilPressure.oldTimeData = CAR_Data.oilPressure.lastTimeData;
		CAR_Data.oilPressure.floatData += 0.0001;
		CAR_Data.oilPressure.intData = CAR_Data.oilPressure.floatData;
		CAR_Data.oilPressure.lastTimeData = millis;

		if(CAR_Data.oilPressure.floatData >= 15)
			CAR_Data.oilPressure.floatData = -15;

		static uint32_t millisTraction = 0;

		if(millis > millisTraction + 7000)
		{
			millisTraction = millis;

			if(CAR_Data.tractionControl.intData < 4)
				CAR_Data.tractionControl.intData++;
			else
				CAR_Data.tractionControl.intData = 0;
		}

		CAR_Data.tractionControl.floatData = CAR_Data.tractionControl.intData;
		CAR_Data.tractionControl.oldTimeData = CAR_Data.tractionControl.lastTimeData;
		CAR_Data.tractionControl.lastTimeData = millis;

		static uint32_t millisGear = 0;

		if(millis > millisGear + 1000)
		{
			millisGear = millis;

			if(CAR_Data.gear.intData < 4)
				CAR_Data.gear.intData++;
			else
				CAR_Data.gear.intData = 0;
		}

		CAR_Data.gear.floatData = CAR_Data.gear.intData;
		CAR_Data.gear.oldTimeData = CAR_Data.gear.lastTimeData;
		CAR_Data.gear.lastTimeData = millis;

		if(CAR_Data.rpm.floatData > 13000)
			CAR_Data.rpm.floatData = 8000;

		CAR_Data.rpm.floatData += 0.1;
		CAR_Data.rpm.intData = CAR_Data.rpm.floatData;
		CAR_Data.rpm.oldTimeData = CAR_Data.rpm.lastTimeData;
		CAR_Data.rpm.lastTimeData = millis;

		CAR_Data.steer.floatData += 0.001;

		if(CAR_Data.steer.floatData > steer_MAX_VALUE)
		{
			CAR_Data.steer.floatData = steer_MIN_VALUE;
		}

		CAR_Data.steer.intData = CAR_Data.steer.floatData;
		CAR_Data.steer.oldTimeData = CAR_Data.rpm.lastTimeData;
		CAR_Data.steer.lastTimeData = millis;

		CAR_Data.brake.floatData -= 0.0002;

		if(CAR_Data.brake.floatData < 1)
		{
			CAR_Data.brake.floatData = 20;
		}

		//CAR_Data.brake.floatData = 20;

		CAR_Data.brake.intData = CAR_Data.brake.floatData;
		CAR_Data.brake.oldTimeData = CAR_Data.brake.lastTimeData;
		CAR_Data.brake.lastTimeData = millis;

		CAR_Data.brakeRear.floatData += 0.0003;

		if(CAR_Data.brakeRear.floatData > 18)
		{
			CAR_Data.brakeRear.floatData = 0;
		}

		CAR_Data.brakeRear.intData = CAR_Data.brakeRear.floatData;
		CAR_Data.brakeRear.oldTimeData = CAR_Data.brakeRear.lastTimeData;
		CAR_Data.brakeRear.lastTimeData = millis;

		CAR_Data.speed.floatData-=0.0007;
		if(CAR_Data.speed.floatData <= 0)
		{
			CAR_Data.speed.floatData = 140;
		}

		CAR_Data.speed.intData = CAR_Data.speed.floatData;
		CAR_Data.speed.oldTimeData = CAR_Data.speed.lastTimeData;
		CAR_Data.speed.lastTimeData = millis;

		END_OF_DEBUG_SECTION:;

		//HAL_GPIO_WritePin(LCD_DISP_GPIO_Port, LCD_DISP_Pin, 1);

#elif DEBUG_MODE == 2
		selectedGui = GuiDrive1;
#endif

		//MDM Debug Code END

		//CAN_DATA_GuiPopUp_Disable(0);		//Traction, 			change
		//CAN_DATA_GuiPopUp_Disable(2);		//Water Temperature, 	range
		//CAN_DATA_GuiPopUp_Disable(3);		//Oil Temperature,		range
		//CAN_DATA_GuiPopUp_Disable(4);		//Fuel Pressure, 		range
		//CAN_DATA_GuiPopUp_Disable(5);		//Oil Pressure, 		range
		CAN_DATA_GuiPopUp_Disable(6);		//RPM,					range
		CAN_DATA_GuiPopUp_Disable(7);		//BSPD,					range
		CAN_DATA_GuiPopUp_Disable(8);		//Water pump,			change
		CAN_DATA_GuiPopUp_Disable(9);		//Water pump,			range

		static uint32_t millisDelayEnableOilPressureAlarm = 0;
		static uint32_t oilPressureAlarmEnableStatus = 0;

		if(CAR_Data.rpm.intData <= 2500)
		{
			CAN_DATA_GuiPopUp_Disable(5);			//Oil Pressure, 		range

			if(CAR_Data.rpm.intData <= 1000)
				CAN_DATA_GuiPopUp_Disable(4);		//Fuel Pressure, 		range

			oilPressureAlarmEnableStatus = 1;
			millisDelayEnableOilPressureAlarm = millis;
		}
		else
		{
			if(oilPressureAlarmEnableStatus == 1 && millis >= millisDelayEnableOilPressureAlarm + 5000)
			{
				CAN_DATA_GuiRangePopUp_Enable(5);	//Oil Pressure, 		range

				CAN_DATA_GuiRangePopUp_Enable(4);	//Fuel Pressure, 		range

				oilPressureAlarmEnableStatus = 0;
			}
		}

		dashboardLedControl();

		DisplayGui();

		__HAL_IWDG_RELOAD_COUNTER(&hiwdg);

	}
  /* USER CODE END 3 */
}

void SystemClock_Config(void)
{
  RCC_OscInitTypeDef RCC_OscInitStruct = {0};
  RCC_ClkInitTypeDef RCC_ClkInitStruct = {0};
  RCC_PeriphCLKInitTypeDef PeriphClkInitStruct = {0};

  /** Configure the main internal regulator output voltage
  */
  __HAL_RCC_PWR_CLK_ENABLE();
  __HAL_PWR_VOLTAGESCALING_CONFIG(PWR_REGULATOR_VOLTAGE_SCALE1);
  /** Initializes the RCC Oscillators according to the specified parameters
  * in the RCC_OscInitTypeDef structure.
  */
  RCC_OscInitStruct.OscillatorType = RCC_OSCILLATORTYPE_LSI|RCC_OSCILLATORTYPE_HSE;
  RCC_OscInitStruct.HSEState = RCC_HSE_ON;
  RCC_OscInitStruct.LSIState = RCC_LSI_ON;
  RCC_OscInitStruct.PLL.PLLState = RCC_PLL_ON;
  RCC_OscInitStruct.PLL.PLLSource = RCC_PLLSOURCE_HSE;
  RCC_OscInitStruct.PLL.PLLM = 25;
  RCC_OscInitStruct.PLL.PLLN = 432;
  RCC_OscInitStruct.PLL.PLLP = RCC_PLLP_DIV2;
  RCC_OscInitStruct.PLL.PLLQ = 8;
  if (HAL_RCC_OscConfig(&RCC_OscInitStruct) != HAL_OK)
  {
    Error_Handler();
  }
  /** Activate the Over-Drive mode
  */
  if (HAL_PWREx_EnableOverDrive() != HAL_OK)
  {
    Error_Handler();
  }
  /** Initializes the CPU, AHB and APB buses clocks
  */
  RCC_ClkInitStruct.ClockType = RCC_CLOCKTYPE_HCLK|RCC_CLOCKTYPE_SYSCLK
                              |RCC_CLOCKTYPE_PCLK1|RCC_CLOCKTYPE_PCLK2;
  RCC_ClkInitStruct.SYSCLKSource = RCC_SYSCLKSOURCE_PLLCLK;
  RCC_ClkInitStruct.AHBCLKDivider = RCC_SYSCLK_DIV1;
  RCC_ClkInitStruct.APB1CLKDivider = RCC_HCLK_DIV4;
  RCC_ClkInitStruct.APB2CLKDivider = RCC_HCLK_DIV2;

  if (HAL_RCC_ClockConfig(&RCC_ClkInitStruct, FLASH_LATENCY_7) != HAL_OK)
  {
    Error_Handler();
  }
  PeriphClkInitStruct.PeriphClockSelection = RCC_PERIPHCLK_LTDC|RCC_PERIPHCLK_USART1
                              |RCC_PERIPHCLK_SDMMC1|RCC_PERIPHCLK_CLK48;
  PeriphClkInitStruct.PLLSAI.PLLSAIN = 192;
  PeriphClkInitStruct.PLLSAI.PLLSAIR = 3;
  PeriphClkInitStruct.PLLSAI.PLLSAIQ = 2;
  PeriphClkInitStruct.PLLSAI.PLLSAIP = RCC_PLLSAIP_DIV4;
  PeriphClkInitStruct.PLLSAIDivQ = 1;
  PeriphClkInitStruct.PLLSAIDivR = RCC_PLLSAIDIVR_4;
  PeriphClkInitStruct.Usart1ClockSelection = RCC_USART1CLKSOURCE_PCLK2;
  PeriphClkInitStruct.Clk48ClockSelection = RCC_CLK48SOURCE_PLLSAIP;
  PeriphClkInitStruct.Sdmmc1ClockSelection = RCC_SDMMC1CLKSOURCE_CLK48;
  if (HAL_RCCEx_PeriphCLKConfig(&PeriphClkInitStruct) != HAL_OK)
  {
    Error_Handler();
  }
}

/* USER CODE BEGIN 4 */

void dashboardLedControl(void)
{
	static uint8_t ledStartingProcedureDone = 0;

	if(ledStartingProcedureDone == 0)
	{
		static uint32_t millisLedStartingProcedure = 0;

		if(millisLedStartingProcedure < 500)
		{
			millisLedStartingProcedure = millis;

			HAL_GPIO_WritePin(_5V_OUT1_GPIO_Port, _5V_OUT1_Pin, 1);
		}
		else if(millisLedStartingProcedure < 2000)
		{
			if(millis >= millisLedStartingProcedure + 50)
			{
				HAL_GPIO_TogglePin(_5V_OUT1_GPIO_Port, _5V_OUT1_Pin);
				millisLedStartingProcedure = millis;
			}
		}
		else if(millisLedStartingProcedure < 2500)
		{
			millisLedStartingProcedure = millis;
			HAL_GPIO_WritePin(_5V_OUT1_GPIO_Port, _5V_OUT1_Pin, 1);
		}
		else
		{
			HAL_GPIO_WritePin(_5V_OUT1_GPIO_Port, _5V_OUT1_Pin, 0);
			ledStartingProcedureDone = 1;
			millisLedStartingProcedure = millis;
		}

		goto END_OF_FUNCTION;
	}

	static uint8_t ledAlarmDetected = 0;

	static uint32_t millisLedAlarmActivation = 0;

	if((CAR_Data.waterTemp.floatData > CAR_Data.waterTemp.maxValue && millis - CAR_Data.waterTemp.lastTimeData <= 100)
			|| (CAR_Data.oilTemp.floatData > CAR_Data.oilTemp.maxValue && millis - CAR_Data.oilTemp.lastTimeData <= 100)
			|| ((CAR_Data.oilTemp.floatData < CAR_Data.oilTemp.minValue && CAR_Data.rpm.intData > 1000 && millis - CAR_Data.oilTemp.lastTimeData <= 100))
			|| (CAR_Data.oilPressure.floatData > CAR_Data.oilPressure.maxValue && millis - CAR_Data.oilPressure.lastTimeData <= 100)
			|| ((CAR_Data.oilPressure.floatData < CAR_Data.oilPressure.minValue && CAR_Data.rpm.intData > 1000 && millis - CAR_Data.oilPressure.lastTimeData <= 100))
			)
	{
		if(millis - millisLedAlarmActivation >= 500)
		{
			ledAlarmDetected = 1;
		}
	}
	else
	{
		millisLedAlarmActivation = millis;
		ledAlarmDetected = 0;
	}

	static uint8_t blinkCounter = 0;

	if(ledAlarmDetected != 0)
	{
		static uint32_t millisLedAlarmDetected = 0;

		if(millis >= millisLedAlarmDetected + 50 && blinkCounter <= 30)
		{
			blinkCounter++;
			HAL_GPIO_TogglePin(_5V_OUT1_GPIO_Port, _5V_OUT1_Pin);
			millisLedAlarmDetected = millis;
		}

		if(blinkCounter >= 10)
			HAL_GPIO_WritePin(_5V_OUT1_GPIO_Port, _5V_OUT1_Pin, 1);
	}
	else
	{
		blinkCounter = 0;
		HAL_GPIO_WritePin(_5V_OUT1_GPIO_Port, _5V_OUT1_Pin, 0);
	}

	END_OF_FUNCTION:;
}

/* USER CODE END 4 */

void Error_Handler(void)
{
  /* USER CODE BEGIN Error_Handler_Debug */
	/* User can add his own implementation to report the HAL error return state */

	DisplayGui_Init();

	__disable_irq(); //Do not remove

	GUI_Clear();
	GUI_SetColor(GUI_RED);
	GUI_SetFont(&GUI_Font32_1);
	GUI_DispStringAt("SETUP ERROR!", (480 - 200) / 2, (272 - 20) / 2);

	GUI_SetTextAlign(GUI_TA_HCENTER);
	GUI_DispDecAt(Error_Handler_Code, 480 / 2, (272 - 20) / 2 + 32, 3);

	DisplayON();

	while (1)
	{
		/*
		 HAL_GPIO_WritePin(LCD_BL_CTRL_GPIO_Port, LCD_BL_CTRL_Pin, 1);
		 HAL_Delay(1000);
		 HAL_GPIO_WritePin(LCD_BL_CTRL_GPIO_Port, LCD_BL_CTRL_Pin, 0);
		 HAL_Delay(500);
		 */
	}
  /* USER CODE END Error_Handler_Debug */
}

/************************ (C) COPYRIGHT STMicroelectronics *****END OF FILE****/
